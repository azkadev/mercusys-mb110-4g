## MB110V1_gpl_src/mtk_ApSoC_4320/linux-2.6.36.x/ralink/Kconfig
```kconfig
menu "Ralink Module"

###########
# Debuging
###########
source "drivers/net/rt_rdm/Kconfig"

#############
# Wire
#############

source "drivers/net/raeth/Kconfig"

config  HW_IPSEC
	depends on RALINK_MT7621
	bool    "HW IPSec Enable"
	    select INET_AH
		select INET_ESP
		select INET_XFRM_MODE_TRANSPORT
		select INET_XFRM_MODE_TUNNEL
		select UNIX
		select XFRM
		select XFRM_USER
		select NET_KEY
		select CRYPTO_AEAD
		select CRYPTO_AUTHENC
		select CRTPTO_RNG
		select CRYPTO_CBC
		select CRYPTO_HMAC
		select CRYPTO_SHA1
		select CRYPTO_MD5
		select CRYPTO_AES
		select CRYPTO_DES
		select CRYPTO_ANSI_CPRNG
		default n

config  RALINK_HWCRYPTO
	depends on HW_IPSEC
	tristate "HW Crypto Engine"
	default m

#############
# Wireless
#############
menuconfig WIFI_DRIVER
	bool "WiFi Driver Support"

if WIFI_DRIVER

choice
	prompt "Choose First WiFi Interface"
	config FIRST_IF_NONE
	bool "None"

	config FIRST_IF_RT2860
	bool "RT2860 for rt2860v2 wifi driver"
	select RTMP_MAC
	select RALINK_RT2860
	
	config FIRST_IF_MT7620
	bool "MT7620 for rlt_wifi wifi driver"
	select RTMP_MAC
	select RALINK_RT6352

	config FIRST_IF_MT7628
	bool "MT7628 for rlt_wifi wifi driver"
	depends on RALINK_MT7628
	select MT_MAC

	config FIRST_IF_RT3092
	bool "RT3092"
	depends on RALINK_MT7621
	select RTMP_MAC
	select RALINK_RT3092
    
	config FIRST_IF_RT5392
	bool "RT5392"
	depends on RALINK_MT7621
	select RTMP_MAC
	select RALINK_RT5392
    	
	config FIRST_IF_RT5592
	bool "RT5592"
	depends on RALINK_MT7621
	select RTMP_MAC
	select RALINK_RT5592
	
	config FIRST_IF_RT3593
	bool "RT3593"
	depends on RALINK_MT7621
	select RTMP_MAC
	select RALINK_RT3593
    
	config FIRST_IF_MT7610E
	bool "MT7610E"
	depends on RALINK_MT7621
	select RLT_MAC
	select RALINK_MT7610E
    
	config FIRST_IF_MT7612E
	bool "MT7612E"
	depends on RALINK_MT7621
	select RLT_MAC
	select RALINK_MT7612E

	config FIRST_IF_MT7602E
	bool "MT7602E"
	depends on RALINK_MT7621
	select RLT_MAC
	select RALINK_MT7602E

	config FIRST_IF_MT7603E
	bool "MT7603E"
	depends on RALINK_MT7621
	select MT_MAC
	select RALINK_MT7603E

	config FIRST_IF_MT7637E
	bool "MT7637E"
	select WIFI_MT_MAC
	select MT_MAC
	select RALINK_MT7637E

endchoice

choice
	prompt "Choose Second WiFi Interface"
	config SECOND_IF_NONE
	bool "None"

	config SECOND_IF_RT3092
	bool "RT3092"
	select RTMP_MAC
	select RALINK_RT3092
    
	config SECOND_IF_RT5392
	bool "RT5392"
	select RTMP_MAC
	select RALINK_RT5392
    	
	config SECOND_IF_RT5592
	bool "RT5592"
	select RTMP_MAC
	select RALINK_RT5592
	
	config SECOND_IF_RT3593
	bool "RT3593"
	select RTMP_MAC
	select RALINK_RT3593
    
	config SECOND_IF_RT3572
	bool "RT3572"
	select RTMP_MAC
	select RALINK_RT3572

	config SECOND_IF_RT5572
	bool "RT5572"
	select RTMP_MAC
	select RALINK_RT5572
    
	config SECOND_IF_MT7620
	bool "MT7620"
	select RTMP_MAC
	select RALINK_RT6352
    
	config SECOND_IF_MT7610U
	bool "MT7610U"
	select RLT_MAC
	select RALINK_MT7610U
    
	config SECOND_IF_MT7610E
	bool "MT7610E"
	select RLT_MAC
	select RALINK_MT7610E
    
	config SECOND_IF_RT8592
	bool "RT85592"
	select RLT_MAC
	select RALINK_RT8592
	
	config SECOND_IF_MT7612U
	bool "MT7612U"
	select RLT_MAC
	select RALINK_MT7612U
    
	config SECOND_IF_MT7612E
	bool "MT7612E"
	select RLT_MAC
	select RALINK_MT7612E

	config SECOND_IF_MT7602E
	bool "MT7602E"
	select RLT_MAC
	select RALINK_MT7602E

	config SECOND_IF_MT7603E
	bool "MT7603E"
	select MT_MAC
	select RALINK_MT7603E
    
    config SECOND_IF_MT7663E
	bool "MT7663E"
	select WIFI_MT_MAC
	select MT7613_MAC
	select CHIP_MT7663E
endchoice

config  RT_FIRST_CARD
        int
        depends on ! FIRST_IF_NONE
        default 2860 if FIRST_IF_RT2860
        default 7620 if FIRST_IF_MT7620
        default 7628 if FIRST_IF_MT7628
        default 3090 if FIRST_IF_RT3092
        default 5392 if FIRST_IF_RT5392
        default 5592 if FIRST_IF_RT5592
        default 3593 if FIRST_IF_RT3593
        default 7610 if FIRST_IF_MT7610E
	default 7612 if FIRST_IF_MT7612E
	default 7602 if FIRST_IF_MT7602E
	default 7603 if FIRST_IF_MT7603E
	default 7637 if FIRST_IF_MT7637E
        
config  RT_SECOND_CARD
        int
        depends on ! SECOND_IF_NONE
        default 3090 if SECOND_IF_RT3092
        default 5392 if SECOND_IF_RT5392
        default 5592 if SECOND_IF_RT5592
        default 3593 if SECOND_IF_RT3593
        default 7610 if SECOND_IF_MT7610E
        default 8592 if SECOND_IF_RT8592
        default 3572 if SECOND_IF_RT3572
        default 5572 if SECOND_IF_RT5572
	default 7612 if SECOND_IF_MT7612E || SECOND_IF_MT7612U
	default 7602 if SECOND_IF_MT7602E
	default 7603 if SECOND_IF_MT7603E
	default 7663e if SECOND_IF_MT7663E
        
config  RT_FIRST_IF_RF_OFFSET
        hex
        depends on ! FIRST_IF_NONE
        default 0x9f0000 if (TP_10M_FLASH)
        default 0xff0000 if (TP_16M_FLASH)
        default 0x7f0000

config  RT_SECOND_IF_RF_OFFSET
        hex
        depends on ! SECOND_IF_NONE
        default 0x9f8000 if (TP_10M_FLASH)
        default 0xff8000 if (TP_16M_FLASH)
        default 0x7f8000

config  RT2860V2_2850
        bool "Dual Band"
        depends on RALINK_RT2880

choice
        prompt "RF Type"
        depends on RALINK_RT5350 
        default RALINK_RT5350_1T1R

        config  RALINK_RT5350_1T1R
        bool "1T1R"
endchoice

choice
        prompt "RF Type"
        depends on RALINK_RT3052
        default RALINK_RT3052_2T2R

        config  RALINK_RT3050_1T1R
        bool "1T1R"

        config  RALINK_RT3051_1T2R
        bool "1T2R"

        config  RALINK_RT3052_2T2R
        bool "2T2R"
endchoice

choice
        prompt "RF Type"
        depends on  RALINK_RT3352 

        config  RALINK_RT3352_2T2R
        bool "2T2R"
endchoice

choice
	prompt "RF Type"
	depends on RALINK_RT3883

	config  RALINK_RT3662_2T2R
	bool "2T3R (RT3662)"

	config  RALINK_RT3883_3T3R
	bool "3T3R (RT3883)"
endchoice

config RTDEV_MII
    bool
    default y if RT2880v2_INIC_MII || RT305x_INIC_MII || RT305x_INIC_USB || RT3680_iNIC_AP

#config  UNIQUE_WPS
#	bool "Unique WPS for Concurrent AP"
#        depends on RT2860V2_AP_WSC 
#        depends on RT3090_AP_WSC || RT3572_AP_WSC || RT5392_AP_WSC || RT5572_AP_WSC || RT5592_AP_WSC
#	default n

#source "drivers/net/wireless/rt2860v2_ap/Kconfig"
#source "drivers/net/wireless/rt2860v2_sta/Kconfig"
#source "drivers/net/wireless/RTPCI_ap/Kconfig"
#source "drivers/net/wireless/RT3090_ap/Kconfig"
#source "drivers/net/wireless/RT5392_ap/Kconfig"
#source "drivers/net/wireless/RT5592_ap/Kconfig"
#source "drivers/net/wireless/RT3593_ap/Kconfig"
#source "drivers/net/wireless/RT3572_ap/Kconfig"
#source "drivers/net/wireless/RT5572_ap/Kconfig"
#source "drivers/net/wireless/iNIC/Kconfig"
#source "drivers/net/wireless/iNIC_RT305x/Kconfig"
#source "drivers/net/wireless/RT3680_ap/Kconfig"
source "drivers/net/wireless/MT7610_ap/Kconfig"
#source "drivers/net/wireless/rlt_wifi/Kconfig"
#source "drivers/net/wireless/mt_wifi/Kconfig"
source "drivers/net/wireless/mt_wifi/embedded/Kconfig"
source "drivers/net/wireless/MT7612/Kconfig"
source "drivers/net/wireless/MT7613/embedded/Kconfig"

endif # WIFI_DRIVER

config RTDEV
	bool
	default y if WIFI_DRIVER && !SECOND_IF_NONE || RTDEV_MII
	default y if RTDEV_PLC

#######
# USB
#######
source "drivers/usb/dwc_otg/Kconfig"

#######
# NAT
#######
choice
prompt "Ralink NAT Type"
	
config  RA_NAT_NONE
bool "None"
config  RA_NAT_HW
bool "Hardware"
depends on !RALINK_RT5350 && !RALINK_MT7628
endchoice

source "net/nat/hw_nat/Kconfig"

source "net/nat/shortcut-fe/Kconfig"

source "net/nat/fast-classifier/Kconfig"

endmenu
```

## MB110V1_gpl_src/mtk_ApSoC_4320/linux-2.6.36.x/sound/soc/codecs/Kconfig
```kconfig
# Helper to resolve issues with configs that have SPI enabled but I2C
# modular, meaning we can't build the codec driver in with I2C support.
# We use an ordered list of conditional defaults to pick the appropriate
# setting - SPI can't be modular so that case doesn't need to be covered.
config SND_SOC_I2C_AND_SPI
	tristate
	default m if I2C=m
	default y if I2C=y
	default y if SPI_MASTER=y

config SND_SOC_ALL_CODECS
	tristate 
	select SND_SOC_L3
	select SND_SOC_AC97_CODEC if SND_SOC_AC97_BUS
	select SND_SOC_AD1836 if SPI_MASTER
	select SND_SOC_AD193X if SND_SOC_I2C_AND_SPI
	select SND_SOC_AD1980 if SND_SOC_AC97_BUS
	select SND_SOC_ADS117X
	select SND_SOC_AD73311 if I2C
	select SND_SOC_AK4104 if SPI_MASTER
	select SND_SOC_AK4535 if I2C
	select SND_SOC_AK4642 if I2C
	select SND_SOC_AK4671 if I2C
	select SND_SOC_CQ0093VC if MFD_DAVINCI_VOICECODEC
	select SND_SOC_CS42L51 if I2C
	select SND_SOC_CS4270 if I2C
	select SND_SOC_DA7210 if I2C
	select SND_SOC_JZ4740 if SOC_JZ4740
	select SND_SOC_MAX9877 if I2C
	select SND_SOC_PCM3008
	select SND_SOC_SPDIF
	select SND_SOC_SSM2602 if I2C
	select SND_SOC_STAC9766 if SND_SOC_AC97_BUS
	select SND_SOC_TLV320AIC23 if I2C
	select SND_SOC_TLV320AIC26 if SPI_MASTER
	select SND_SOC_TLV320AIC3X if I2C
	select SND_SOC_TPA6130A2 if I2C
	select SND_SOC_TLV320DAC33 if I2C
	select SND_SOC_TWL4030 if TWL4030_CORE
	select SND_SOC_TWL6040 if TWL4030_CORE
	select SND_SOC_UDA134X
	select SND_SOC_UDA1380 if I2C
	select SND_SOC_WM2000 if I2C
	select SND_SOC_WM8350 if MFD_WM8350
	select SND_SOC_WM8400 if MFD_WM8400
	select SND_SOC_WM8510 if SND_SOC_I2C_AND_SPI
	select SND_SOC_WM8523 if I2C
	select SND_SOC_WM8580 if I2C
	select SND_SOC_WM8711 if SND_SOC_I2C_AND_SPI
	select SND_SOC_WM8727
	select SND_SOC_WM8728 if SND_SOC_I2C_AND_SPI
	select SND_SOC_WM8731 if SND_SOC_I2C_AND_SPI
	select SND_SOC_WM8741 if SND_SOC_I2C_AND_SPI
	select SND_SOC_WM8750 if SND_SOC_I2C_AND_SPI
	select SND_SOC_WM8753 if SND_SOC_I2C_AND_SPI
	select SND_SOC_WM8776 if SND_SOC_I2C_AND_SPI
	select SND_SOC_WM8900 if I2C
	select SND_SOC_WM8903 if I2C
	select SND_SOC_WM8904 if I2C
	select SND_SOC_WM8940 if I2C
	select SND_SOC_WM8955 if I2C
	select SND_SOC_WM8960 if I2C
	select SND_SOC_WM8961 if I2C
	select SND_SOC_WM8971 if I2C
	select SND_SOC_WM8974 if I2C
	select SND_SOC_WM8978 if I2C
	select SND_SOC_WM8988 if SND_SOC_I2C_AND_SPI
	select SND_SOC_WM8990 if I2C
	select SND_SOC_WM8993 if I2C
	select SND_SOC_WM8994 if MFD_WM8994
	select SND_SOC_WM9081 if I2C
	select SND_SOC_WM9090 if I2C
	select SND_SOC_WM9705 if SND_SOC_AC97_BUS
	select SND_SOC_WM9712 if SND_SOC_AC97_BUS
	select SND_SOC_WM9713 if SND_SOC_AC97_BUS
        help
          Normally ASoC codec drivers are only built if a machine driver which
          uses them is also built since they are only usable with a machine
          driver.  Selecting this option will allow these drivers to be built
          without an explicit machine driver for test and development purposes.

	  Support for the bus types used to access the codecs to be built must
	  be selected separately.

          If unsure select "N".

config SND_SOC_WM_HUBS
	tristate
	default y if SND_SOC_WM8993=y || SND_SOC_WM8994=y
	default m if SND_SOC_WM8993=m || SND_SOC_WM8994=m

config SND_SOC_AC97_CODEC
	tristate
	select SND_AC97_CODEC

config SND_SOC_AD1836
	tristate

config SND_SOC_AD193X
	tristate

config SND_SOC_AD1980
	tristate

config SND_SOC_AD73311
	tristate
	
config SND_SOC_ADS117X
	tristate

config SND_SOC_AK4104
	tristate

config SND_SOC_AK4535
	tristate

config SND_SOC_AK4642
	tristate

config SND_SOC_AK4671
	tristate

config SND_SOC_CQ0093VC
	tristate

config SND_SOC_CS42L51
	tristate

# Cirrus Logic CS4270 Codec
config SND_SOC_CS4270
	tristate

# Cirrus Logic CS4270 Codec VD = 3.3V Errata
# Select if you are affected by the errata where the part will not function
# if MCLK divide-by-1.5 is selected and VD is set to 3.3V.  The driver will
# not select any sample rates that require MCLK to be divided by 1.5.
config SND_SOC_CS4270_VD33_ERRATA
	bool
	depends on SND_SOC_CS4270

config SND_SOC_CX20442
	tristate

config SND_SOC_JZ4740_CODEC
	tristate

config SND_SOC_L3
       tristate

config SND_SOC_DA7210
        tristate

config SND_SOC_PCM3008
       tristate

config SND_SOC_SPDIF
	tristate

config SND_SOC_SSM2602
	tristate

config SND_SOC_STAC9766
	tristate

config SND_SOC_TLV320AIC23
	tristate

config SND_SOC_TLV320AIC26
	tristate "TI TLV320AIC26 Codec support" if SND_SOC_OF_SIMPLE
	depends on SPI

config SND_SOC_TLV320AIC3X
	tristate

config SND_SOC_TLV320DAC33
	tristate

config SND_SOC_TWL4030
	select TWL4030_CODEC
	tristate

config SND_SOC_TWL6040
	tristate

config SND_SOC_UDA134X
       tristate

config SND_SOC_UDA1380
        tristate

choice
	prompt "WM Codec Support Select"
	depends on RALINK_GDMA
	default SND_SOC_WM8960
	config SND_SOC_WM8750
		bool "Build WM8750 CODEC drivers"
	config SND_SOC_WM8960
		bool "Build WM8960 CODEC drivers"
endchoice
# Amp
config SND_SOC_MAX9877
	tristate

config SND_SOC_TPA6130A2
	tristate

config SND_SOC_WM2000
	tristate

config SND_SOC_WM9090
	tristate
```

## MB110V1_gpl_src/mtk_ApSoC_4320/linux-2.6.36.x/sound/soc/mtk/Kconfig
```kconfig
config SND_RALINK_SOC
	tristate "SoC Audio for Ralink SoC"
	depends on SND_SOC && (RALINK_MT7620 || RALINK_MT7621 || CONFIG_RALINK_MT7628) 
	select I2C
	select I2C_BOARDINFO
	select I2C_COMPAT
	select I2C_CHARDEV
	select I2C_HELPER_AUTO
	select I2C_RALINK
	default y if (RALINK_MT7620=y || RALINK_MT7621=y || CONFIG_RALINK_MT7628=y)
	
	help
	  Say Y or M if you want to add support for codecs attached to
	  the MTK I2S interface.
```

## MB110V1_gpl_src/mtk_ApSoC_4320/linux-2.6.36.x/tpModel/Kconfig
```kconfig
menu "TPLINK Model"

choice
       prompt "TP-LINK Product MODEL"
       default TP_MODEL_MR3420V5

config TP_MODEL_C20iV1
       bool "Build ArcherC20i V1"

config TP_MODEL_C2V1
       bool "Build ArcherC2 V1"
	   
config TP_MODEL_C20V1
       bool "Build ArcherC20 V1"
	   
config TP_MODEL_C50V1
       bool "Build ArcherC50 V1"

config TP_MODEL_C50V4
       bool "Build ArcherC50 V4"
	   
config TP_MODEL_WR840NV4
       bool "Build TL-WR840N V4"

config TP_MODEL_WR841NV13
       bool "Build TL-WR841N V13"

config TP_MODEL_WR845NV3
       bool "Build TL-WR845N V3"

config TP_MODEL_C20V4
       bool "Build ArcherC20 V4"

config TP_MODEL_MR3420V5
       bool "Build MR3420 V5"
	   
config TP_MODEL_MR3020V3
       bool "Build MR3020 V3"

config TP_MODEL_MR6400V3
       bool "Build MR6400 V3"
       
config TP_MODEL_MR400V4
       bool "Build MR400 V4"

config TP_MODEL_MR6400V5
       bool "Build MR6400 V5"

config TP_MODEL_MR200V5
       bool "Build MR200 V5"

config TP_MODEL_MR100V1
       bool "Build MR100 V1"

config TP_MODEL_MR100V2
       bool "Build MR100 V2"

config TP_MODEL_MB110V1
       bool "Build MB110 V1"
endchoice

config TP_MEMORY_OPTIMIZATION
       bool "TP_MEMORY_OPTIMIZATION"

config TP_4M_FLASH
       bool "USE 4M FLASH"

config TP_10M_FLASH
       bool "TP_10M_FLASH"

   config TP_16M_FLASH
       bool "TP_16M_FLASH"
endmenu
```
