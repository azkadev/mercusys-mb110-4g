## MB110V1_gpl_src/mtk_ApSoC_4320/linux-2.6.36.x/arch/mips/kprofile/Kconfig
```kconfig
config KPROFILE
       bool "Kprofile"
       depends on SYS_HAS_CPU_MIPS32_R1
       help
```

## MB110V1_gpl_src/mtk_ApSoC_4320/linux-2.6.36.x/drivers/net/wireless/MT7612_ap/Kconfig
```kconfig
config MT7612_AP
	tristate "MediaTek RLT MT7612 WiFi AP Support"
#	depends on NET_RADIO 
	select WIRELESS_EXT
	select WEXT_SPY
	select WEXT_PRIV

config WDS_SUPPORT
	bool "WDS"
	depends on MT7612_AP
	default n

config MBSS_SUPPORT
	bool "MBSSID"
	depends on MT7612_AP
	default n

config SNIFFER_SUPPORT
	bool "SNIFFER"
	depends on MT7612_AP
	default n

config CFG80211_SUPPORT
	bool "CFG80211"
	depends on MT7612_AP
	default n

config NEW_MBSSID_MODE
	bool "New MBSSID Mode"
	depends on MT7612_AP || RALINK_RT3883 || RALINK_RT3352 || RALINK_RT5350 || RALINK_RT6352 || RALINK_MT7620
	depends on MBSS_SUPPORT
	default n

config ENHANCE_NEW_MBSSID_MODE
    bool "Enhanced MBSSID Mode"
    depends on NEW_MBSSID_MODE
    default n

config APCLI_SUPPORT
	bool "AP-Client Support"
	depends on MT7612_AP
	default n

config APCLI_CERT_SUPPORT
    bool "AP-Client TGn Cert Support"
	depends on MT7612_AP
    depends on APCLI_SUPPORT
        default n

config MAC_REPEATER_SUPPORT
	bool "MAC Repeater Support"
	depends on MT7612_AP || RALINK_RT6352 || RALINK_MT7620
	depends on APCLI_SUPPORT
	default n

config MWDS_SUPPORT
	bool "MWDS Support"
	depends on MT7612_AP || RALINK_RT6352 || RALINK_MT7620
	default y

config DFS_SUPPORT
	bool "DFS Support"
	depends on MT7612_AP
	select RALINK_TIMER_DFS

config LLTD_SUPPORT
	bool "LLTD (Link Layer Topology Discovery Protocol)"
	depends on MT7612_AP
	default n

config NINTENDO_AP
	bool "Nintendo AP Support"
	depends on MT7612_AP
	default n

config COC_SUPPORT
	bool "CoC Support"
	depends on MT7612_AP
	default n

config DELAYED_TCP_ACK_SUPPORT
	bool "Delayed TCP ACK Support"
	depends on MT7612_AP
	default n

config BAND_STEERING
	bool "Band Steering"
	depends on MT7612_AP
	default n

config MCAST_RATE_SPECIFIC
	bool "User Specific Tx Rate of MCAST Packet"
	depends on MT7612_AP
	default n

config THERMAL_PROTECT_SUPPORT
	bool "Thermal Protection Support"
	depends on MT7612_AP
	default n	

config CON_WPS_SUPPORT
	bool "Concurrent WPS Support"
	depends on RLT_AP_SUPPORT
	depends on APCLI_SUPPORT
	depends on WSC_INCLUDED
	depends on WSC_V2_SUPPORT
	default n
	
#config MESH_SUPPORT
#   bool "MESH Support"
#   depends on MT7612_AP

config DOT11R_FT_SUPPORT
    bool "802.11r Fast BSS Transition"
    depends on MT7612_AP
	default n
#11K
config DOT11K_RRM_SUPPORT
    bool "802.11k Radio Resource Management"
    depends on MT7612_AP
    default n

#11v
config DOT11V_WNM_SUPPORT
	bool "802.11v Support"
	depends on MT7612_AP
	default y

#tp-roaming
config TP_NETWORK_ROAMING
	bool "tp-network-roaming"
	depends on MT7612_AP
	depends on DOT11K_RRM_SUPPORT
	depends on DOT11V_WNM_SUPPORT
	default y

#config RT2860V2_SNMP
#	bool "Net-SNMP Support"
#	depends on MT7612_AP

#config EXT_BUILD_CHANNEL_LIST
#	bool "Extension Channel List"
#	depends on MT7612_AP

#config AUTO_CH_SELECT_ENHANCE
#	bool "Auto Channel Selection Enhancement"
#	depends on MT7612_AP

#TP-Link IE
config TP_IE_SUPPORT
       bool "TP-Link Spcific Vendor IE support"
       depends on MT7612_AP
       default n

config MT7612_Acceleration
    bool "MT7612_AP wifi Acceleration"
    depends on MT7612_AP && !RA_NAT_NONE
	default n

config DMA_BUSY_RESET
    bool "DMA busy reset, WlanResetB"
    depends on MT7612_AP
	default n
```

## MB110V1_gpl_src/mtk_ApSoC_4320/linux-2.6.36.x/drivers/net/wireless/mt_wifi/embedded/Kconfig
```kconfig
config MT_WIFI
	tristate "MT WIFI Driver"
	select WIFI_BASIC_FUNC if MT_WIFI

#config MT_WIFI_PATH
#		string
#		depends on MT_WIFI
#		default "rlt_wifi"

if MT_WIFI
menu "WiFi Generic Feature Options"
choice
		prompt "EEPROM Type of 1st Card"
		depends on ! FIRST_IF_NONE

		config FIRST_IF_EEPROM_FLASH
		bool "FLASH"
endchoice

config RT_FIRST_CARD_EEPROM
		string
		depends on ! FIRST_IF_NONE
		default "flash" if FIRST_IF_EEPROM_FLASH

choice
		prompt "EEPROM Type of 2nd Card"
		depends on ! SECOND_IF_NONE

		config SECOND_IF_EEPROM_PROM
		bool "EEPROM"

		config SECOND_IF_EEPROM_EFUSE
		bool "EFUSE"

		config SECOND_IF_EEPROM_FLASH
		bool "FLASH"
endchoice

config RT_SECOND_CARD_EEPROM
		string
		depends on ! SECOND_IF_NONE
		default "prom" if SECOND_IF_EEPROM_PROM
		default "efuse" if SECOND_IF_EEPROM_EFUSE
		default "flash" if SECOND_IF_EEPROM_FLASH
		
config MULTI_INF_SUPPORT
		bool
		default y if !FIRST_IF_NONE && !SECOND_IF_NONE
		
config WIFI_BASIC_FUNC
	bool "Basic Functions"
	select WIRELESS_EXT
	select WEXT_SPY
	select WEXT_PRIV
        
config MT7628_WSC_INCLUDED
	bool "WSC (WiFi Simple Config)"
	depends on WIFI_DRIVER
	depends on MT7628_AP_SUPPORT
	default y

config MT7628_WSC_V2_SUPPORT
	bool "WSC V2(WiFi Simple Config Version 2.0)"
	depends on WIFI_DRIVER
	depends on MT7628_AP_SUPPORT
	default y

config MT7628_DOT11W_PMF_SUPPORT
	bool "PMF"
	depends on WIFI_DRIVER
	depends on MT7628_AP_SUPPORT
	default y

config MT7628_LLTD_SUPPORT
	bool "LLTD (Link Layer Topology Discovery Protocol)"
	depends on WIFI_DRIVER
	depends on MT7628_AP_SUPPORT
	default n

config MT7628_QOS_DLS_SUPPORT
	bool "802.11e DLS ((Direct-Link Setup) Support"
	depends on WIFI_DRIVER
	depends on MT7628_AP_SUPPORT
	default n

#config MT7628_WAPI_SUPPORT
#	bool "WAPI Support"
#	depends on WIFI_DRIVER
#	default n

config MT7628_FTM_SUPPORT
	bool "FTM Support"
	depends on WIFI_DRIVER
	select MT7628_PASSPOINT_R2
	default n

config MT7628_IGMP_SNOOP_SUPPORT
	bool "IGMP snooping"
	depends on WIFI_DRIVER
	depends on MT7628_AP_SUPPORT
	default n

config MT7628_BLOCK_NET_IF
	bool "NETIF Block"
	depends on WIFI_DRIVER
	depends on MT7628_AP_SUPPORT
	default n
	help
	Support Net interface block while Tx-Sw queue full

config MT7628_RATE_ADAPTION
	bool "New Rate Adaptation support"
	depends on WIFI_DRIVER
	default y

config MT7628_NEW_RATE_ADAPT_SUPPORT
	bool "Intelligent Rate Adaption"
	depends on WIFI_DRIVER && MT7628_RATE_ADAPTION
	default y

config MT7628_AGS_SUPPORT
	bool "Adaptive Group Switching"
	depends on WIFI_DRIVER && MT7628_RATE_ADAPTION
	depends on MT7628_AP_SUPPORT
	default n

config MT7628_IDS_SUPPORT
	bool "IDS (Intrusion Detection System) Support"
	depends on WIFI_DRIVER
	depends on MT7628_AP_SUPPORT
	default n

config MT7628_WIFI_WORK_QUEUE
	bool "Work Queue"
	depends on WIFI_DRIVER
	default n

config MT7628_WIFI_SKB_RECYCLE
	bool "SKB Recycle(Linux)"
	depends on WIFI_DRIVER
	depends on MT7628_AP_SUPPORT
	default n

config MT7628_SMART_CARRIER_SENSE_SUPPORT
        bool "Smart Carrier Sense"
        depends on WIFI_DRIVER
        default y

config MT7628_LED_CONTROL_SUPPORT
	bool "LED Support"
	depends on WIFI_DRIVER
	depends on MT7628_AP_SUPPORT
	default n

config MT7628_ATE_SUPPORT
	bool "ATE/QA Support"
	depends on WIFI_DRIVER
	depends on MT7628_AP_SUPPORT
	default n

config MT7628_MEMORY_OPTIMIZATION
	bool "Memory Optimization"
	depends on WIFI_DRIVER
	default n

config MT7628_PASSPOINT_R2
	bool "Passpoint Release-2 Support"
	depends on WIFI_DRIVER
	select MT7628_DOT11W_PMF_SUPPORT
	depends on MT7628_AP_SUPPORT
	default n

#config MT7628_TRACE_IPARP
#	bool "IP/ARP trace log"
#	depends on WIFI_DRIVER

config MT7628_SINGLE_SKU
	bool "Single SKU Support"
	depends on MT7628_AP_SUPPORT
	default n

config MT7628_UAPSD
	bool "UAPSD support"
	depends on WIFI_DRIVER
	depends on MT7628_AP_SUPPORT
	default y
	
config MT7628_MWDS_SUPPORT
	bool "MWDS Support"
	depends on MT7628_AP_SUPPORT
	default y

#11R
config MT7628_DOT11R_FT_SUPPORT
	bool "802.11r Fast BSS Transition"
	depends on MT7628_AP_SUPPORT
	default n

#11K
config MT7628_DOT11K_RRM_SUPPORT
	bool "802.11k Radio Resource Management"
	depends on MT7628_AP_SUPPORT
	default y

#11v
config MT7628_DOT11V_WNM_SUPPORT
	bool "802.11v Support"
	depends on MT7628_AP_SUPPORT
	default y

#tp-roaming
config MT7628_TP_NETWORK_ROAMING
	bool "tp-network-roaming"
	depends on MT7628_RLT_AP_SUPPORT
	depends on MT7628_DOT11K_RRM_SUPPORT
	depends on MT7628_DOT11V_WNM_SUPPORT
	default y

#TP-Link IE
config MT7628_TP_IE_SUPPORT
       bool "TP-Link Spcific Vendor IE support"
       depends on MT7628_AP_SUPPORT
       default n

#
# Section for chip architectures
#
# "MT MAC Support"
config MT_MAC
	bool
	depends on WIFI_DRIVER
	default n

# "RLT MAC Support"
#config RLT_MAC
#	bool
#	depends on WIFI_DRIVER
#	default n

#config RLT_BBP
#	bool

#config RLT_RF
#	bool

# "RTMP MAC Support"
#config RTMP_MAC
#	bool
#	depends on WIFI_DRIVER
#	default n

#config RTMP_BBP
#    	bool

#config RTMP_RF
#    	bool

#
# Section for interfaces
#
config RTMP_PCI_SUPPORT
    	bool

config RTMP_USB_SUPPORT
		bool

config RTMP_RBUS_SUPPORT
    	bool

endmenu

menu "WiFi Operation Modes"
	choice
		prompt "Main Mode"
		default MT_WIFI_MODE_AP

		config MT_WIFI_MODE_AP
				bool "AP"
				select MT_AP_SUPPORT

		config MT_WIFI_MODE_STA
				bool "STA"
				select MT_STA_SUPPORT

		config MT_WIFI_MODE_BOTH
				bool "APSTA"
				select MT_AP_SUPPORT
				select MT_STA_SUPPORT

    endchoice

    if MT_WIFI_MODE_AP || MT_WIFI_MODE_BOTH
		source "drivers/net/wireless/mt_wifi_ap/Kconfig"
    endif

#    if MT_WIFI_MODE_STA || MT_WIFI_MODE_BOTH
#		source "drivers/net/wireless/mt_wifi_sta/Kconfig"
#    endif

config MT_AP_SUPPORT
		bool

config MT_STA_SUPPORT
		bool

endmenu	

endif
```

## MB110V1_gpl_src/mtk_ApSoC_4320/linux-2.6.36.x/drivers/net/wireless/mt_wifi/embedded/Kconfig.ap.mt
```kconfig
config MT_WIFI
	tristate "MT WIFI Driver"
	select WIFI_BASIC_FUNC if MT_WIFI

config MT_WIFI_PATH
		string
		depends on MT_WIFI
		default "rlt_wifi"

if MT_WIFI
menu "WiFi Generic Feature Options"
choice
		prompt "EEPROM Type of 1st Card"
		depends on ! FIRST_IF_NONE

		config FIRST_IF_EEPROM_FLASH
		bool "FLASH"
endchoice

config RT_FIRST_CARD_EEPROM
		string
		depends on ! FIRST_IF_NONE
		default "flash" if FIRST_IF_EEPROM_FLASH

#choice
#		prompt "EEPROM Type of 2nd Card"
#		depends on ! SECOND_IF_NONE

#		config SECOND_IF_EEPROM_PROM
#		bool "EEPROM"

#		config SECOND_IF_EEPROM_EFUSE
#		bool "EFUSE"

#		config SECOND_IF_EEPROM_FLASH
#		bool "FLASH"
#endchoice

#config RT_SECOND_CARD_EEPROM
#		string
#		depends on ! SECOND_IF_NONE
#		default "prom" if SECOND_IF_EEPROM_PROM
#		default "efuse" if SECOND_IF_EEPROM_EFUSE
#		default "flash" if SECOND_IF_EEPROM_FLASH
		
#config MULTI_INF_SUPPORT
#		bool
#		default y if !FIRST_IF_NONE && !SECOND_IF_NONE
		
config WIFI_BASIC_FUNC
	bool "Basic Functions"
	select WIRELESS_EXT
	select WEXT_SPY
	select WEXT_PRIV
        
config MT_WSC_INCLUDED
	bool "WSC (WiFi Simple Config)"
	depends on WIFI_DRIVER
	default y

config MT_WSC_V2_SUPPORT
	bool "WSC V2(WiFi Simple Config Version 2.0)"
	depends on WIFI_DRIVER
	default y

config MT_DOT11W_PMF_SUPPORT
	bool "PMF"
	depends on WIFI_DRIVER
	default y

config MT_LLTD_SUPPORT
	bool "LLTD (Link Layer Topology Discovery Protocol)"
	depends on WIFI_DRIVER
	default n

config MT_QOS_DLS_SUPPORT
	bool "802.11e DLS ((Direct-Link Setup) Support"
	depends on WIFI_DRIVER
	default n

config MT_WAPI_SUPPORT
	bool "WAPI Support"
	depends on WIFI_DRIVER
	default n

#config CARRIER_DETECTION_SUPPORT
#	bool "Carrier Detect"
#	depends on WIFI_DRIVER
#	default n

config MT_IGMP_SNOOP_SUPPORT
	bool "IGMP snooping"
	depends on WIFI_DRIVER
	default n

config MT_BLOCK_NET_IF
	bool "NETIF Block"
	depends on WIFI_DRIVER
	default n
	help
	Support Net interface block while Tx-Sw queue full

config MT_RATE_ADAPTION
	bool "New Rate Adaptation support"
	depends on WIFI_DRIVER
	default y

config MT_NEW_RATE_ADAPT_SUPPORT
	bool "Intelligent Rate Adaption"
	depends on WIFI_DRIVER && MT_RATE_ADAPTION
	default y

config MT_AGS_SUPPORT
	bool "Adaptive Group Switching"
	depends on WIFI_DRIVER && MT_RATE_ADAPTION
	default n
    
config MT_IDS_SUPPORT
	bool "IDS (Intrusion Detection System) Support"
	depends on WIFI_DRIVER
	default n

config MT_WIFI_WORK_QUEUE
	bool "Work Queue"
	depends on WIFI_DRIVER
	default n

config MT_WIFI_SKB_RECYCLE
	bool "SKB Recycle(Linux)"
	depends on WIFI_DRIVER
	default n

#config RTMP_FLASH_SUPPORT
#	bool "Flash Support"
#	depends on WIFI_DRIVER
#	default y

config MT_SMART_CARRIER_SENSE_SUPPORT
        bool "Smart Carrier Sense"
        depends on WIFI_DRIVER
        default y

config MT_LED_CONTROL_SUPPORT
	bool "LED Support"
	depends on WIFI_DRIVER
	default n

config MT_ATE_SUPPORT
	bool "ATE/QA Support"
	depends on WIFI_DRIVER
	default n

config MT_MEMORY_OPTIMIZATION
	bool "Memory Optimization"
	depends on WIFI_DRIVER
	default n
	
config MT_SINGLE_SKU
	bool "Single SKU Support"
	depends on WIFI_DRIVER
	default n
	
config MT_UAPSD
	bool "UAPSD support"
	depends on WIFI_DRIVER
	default y

#
# Section for chip architectures
#
# "RLT MAC Support"
#
# Section for interfaces
#
config RTMP_PCI_SUPPORT
    	bool

config RTMP_USB_SUPPORT
		bool

config RTMP_RBUS_SUPPORT
    	bool

endmenu

menu "WiFi Operation Modes"
	choice
		prompt "Main Mode"
		default MT_WIFI_MODE_AP

		config MT_WIFI_MODE_AP
				bool "AP"

		config MT_WIFI_MODE_STA
				bool "STA"

		config MT_WIFI_MODE_BOTH
				bool "APSTA"
    endchoice

    if MT_WIFI_MODE_AP || MT_WIFI_MODE_BOTH
		source "drivers/net/wireless/mt_wifi_ap/Kconfig"
    endif

    #if MT_WIFI_MODE_STA || MT_WIFI_MODE_BOTH

		#source "drivers/net/wireless/mt_wifi_sta/Kconfig"

    #endif

endmenu	

endif

#if MT_MAC
if RALINK_MT7603E
	config MT_MAC
		bool
		default y
endif
```
