## MB110V1_gpl_src/mtk_ApSoC_4320/linux-2.6.36.x/drivers/net/wireless/mt_wifi_ap/Kconfig
```kconfig
config MT7628_AP_SUPPORT
	tristate "Mediatek MT7628 802.11n AP support"
	depends on MT_WIFI
	select WIRELESS_EXT
	select WEXT_SPY
	select WEXT_PRIV
	default y

config MT7628_WDS_SUPPORT
	bool "WDS"
	depends on MT7628_AP_SUPPORT

config MT7628_MBSS_SUPPORT
	bool "MBSSID"
	depends on MT7628_AP_SUPPORT
	default y

config MT7628_NEW_MBSSID_MODE
	bool "New MBSSID MODE"
	depends on MT7628_AP_SUPPORT && MT7628_MBSS_SUPPORT
	depends on RALINK_RT3883 || RALINK_RT3352 || RALINK_RT5350 || RALINK_RT6352 || RALINK_MT7620 || RALINK_MT7628
	default y

config MT7628_ENHANCE_NEW_MBSSID_MODE
	bool "Enhanced MBSSID mode"
	depends on MT7628_NEW_MBSSID_MODE
	default y

config MT7628_APCLI_SUPPORT
	bool "AP-Client Support"
	depends on MT7628_AP_SUPPORT

config MT7628_APCLI_AUTO_BW_SUPPORT
	bool "AP-Client Auto Bandwidth Support"
	depends on MT7628_AP_SUPPORT
        depends on MT7628_APCLI_SUPPORT
        
config MT7628_APCLI_CERT_SUPPORT
	bool "AP-Client TGN Cert Support"
	depends on MT7628_AP_SUPPORT
        depends on MT7628_APCLI_SUPPORT 
               
config MT7628_MAC_REPEATER_SUPPORT
	bool "MAC Repeater Support"
	depends on MT7628_AP_SUPPORT
	depends on MT7628_APCLI_SUPPORT
	default n

config MT7628_MWDS_SUPPORT
	bool "MWDS Support"
	depends on MT7628_AP_SUPPORT
	default y

#11R
config MT7628_DOT11R_FT_SUPPORT
	bool "802.11r Fast BSS Transition"
	depends on MT7628_AP_SUPPORT
	default n
#11K
config MT7628_DOT11K_RRM_SUPPORT
	bool "802.11k Radio Resource Management"
	depends on MT7628_AP_SUPPORT
	default y

#11v
config MT7628_DOT11V_WNM_SUPPORT
	bool "802.11v Support"
	depends on MT7628_AP_SUPPORT
	default y

#tp-roaming
config MT7628_TP_NETWORK_ROAMING
	bool "tp-network-roaming"
	depends on MT7628_DOT11K_RRM_SUPPORT
	depends on MT7628_DOT11V_WNM_SUPPORT
	default y

#TP-Link IE
config MT7628_TP_IE_SUPPORT
       bool "TP-Link Spcific Vendor IE support"
       depends on MT7628_AP_SUPPORT
       default n

config MT7628_SNIFFER_SUPPORT
	bool "SNIFFER"
	depends on MT7628_AP_SUPPORT
	default n

#config MT7628_CFG80211_SUPPORT
#	bool "CFG80211"
#	depends on MT7628_AP_SUPPORT
#	default n

config MT7628_CON_WPS_SUPPORT
	bool "Concurrent WPS Support"
	depends on MT7628_AP_SUPPORT
	depends on MT7628_APCLI_SUPPORT
	depends on MT7628_WSC_INCLUDED
	depends on MT7628_WSC_V2_SUPPORT
	default n
	
config MT7628_LLTD_SUPPORT
	bool "LLTD (Link Layer Topology Discovery Protocol)"
	depends on MT7628_AP_SUPPORT

#config MT7628_COC_SUPPORT
#	bool "CoC Support"
#	depends on MT7628_AP_SUPPORT
#	default n

#config  MT7628_SNMP
#	bool "Net-SNMP Support"
#	depends on MT7628_AP_SUPPORT

#config MT7628_MCAST_RATE_SPECIFIC
#	bool "User specific tx rate of mcast pkt"
#	depends on MT7628_AP_SUPPORT

#config MT7628_EXT_BUILD_CHANNEL_LIST
#	bool "Extension Channel List"
#	depends on MT7628_AP_SUPPORT

#config MT7628_AUTO_CH_SELECT_ENHANCE
#	bool "Auto Channel Selection Enhancement"
#	depends on MT7628_AP_SUPPORT

config MT7628_AIRPLAY_SUPPORT
	bool "AIRPLAY Support"
	depends on MT7628_AP_SUPPORT
	default n

config MT7628_BAND_STEERING
	bool "Band Steering"
	depends on MT7628_AP_SUPPORT
	default n

config MT7628_DUTY_ADMIT_SUPPORT
	bool "Duty Admit Support"
	depends on MT7628_AP_SUPPORT
	default n
```

## MB110V1_gpl_src/mtk_ApSoC_4320/linux-2.6.36.x/drivers/net/wireless/mt_wifi_ap/Kconfig.ap.mt
```kconfig
config MT_AP_SUPPORT
	tristate "Ralink RT2860 802.11n AP support"
#	depends on NET_RADIO 
	select WIRELESS_EXT
	select WEXT_SPY
	select WEXT_PRIV

config MT_WDS_SUPPORT
	bool "WDS"
	depends on MT_AP_SUPPORT

config MT_MBSS_SUPPORT
	bool "MBSSID"
	depends on MT_AP_SUPPORT
	default y

config MT_NEW_MBSSID_MODE
	bool "New MBSSID MODE"
	depends on MT_AP_SUPPORT && MT_MBSS_SUPPORT
	depends on RALINK_RT3883 || RALINK_RT3352 || RALINK_RT5350 || RALINK_RT6352 || RALINK_MT7620
	default y

config MT_ENHANCE_NEW_MBSSID_MODE
	bool "Enhanced MBSSID mode"
	depends on MT_NEW_MBSSID_MODE
	default y

config MT_APCLI_SUPPORT
	bool "AP-Client Support"
	depends on MT_AP_SUPPORT

config MT_APCLI_AUTO_BW_SUPPORT
	bool "AP-Client Auto Bandwidth Support"
	depends on MT_AP_SUPPORT
        depends on MT_APCLI_SUPPORT

config MT_APCLI_CERT_SUPPORT
	bool "AP-Client TGN Cert Support"
	depends on MT_AP_SUPPORT
        depends on MT_APCLI_SUPPORT
        
config MT_MAC_REPEATER_SUPPORT
	bool "MAC Repeater Support"
	depends on MT_AP_SUPPORT
	depends on MT_APCLI_SUPPORT
	depends on RALINK_RT6352 || RALINK_MT7620 || RALINK_MT7603E || MT_AP_SUPPORT
	default n

config MT_DOT11R_FT_SUPPORT
	bool "802.11r Fast BSS Transition"
	depends on MT_AP_SUPPORT

#config DOT11K_RRM_SUPPORT
#	bool "802.11k Radio Resource Management"
#	depends on MT_AP_SUPPORT

#config MT_SNIFFER_SUPPORT
#	bool "SNIFFER"
#	depends on MT_AP_SUPPORT
#	default n

#config MT_CFG80211_SUPPORT
#	bool "CFG80211"
#	depends on MT_AP_SUPPORT
#	default n

#config CON_WPS_SUPPORT
#	bool "Concurrent WPS Support"
#	depends on MT_AP_SUPPORT
#	depends on MT_APCLI_SUPPORT
#	depends on MT_WSC_INCLUDED
#	depends on MT_WSC_V2_SUPPORT
#	default n
	
config MT_LLTD_SUPPORT
	bool "LLTD (Link Layer Topology Discovery Protocol)"
	depends on MT_AP_SUPPORT

#config MT_COC_SUPPORT
#	bool "CoC Support"
#	depends on MT_AP_SUPPORT
#	default n

#config  RT2860V2_SNMP
#	bool "Net-SNMP Support"
#	depends on MT_AP_SUPPORT

#config MCAST_RATE_SPECIFIC
#	bool "User specific tx rate of mcast pkt"
#	depends on MT_AP_SUPPORT

#config EXT_BUILD_CHANNEL_LIST
#	bool "Extension Channel List"
#	depends on MT_AP_SUPPORT

#config AUTO_CH_SELECT_ENHANCE
#	bool "Auto Channel Selection Enhancement"
#	depends on MT_AP_SUPPORT

config AIRPLAY_SUPPORT
	bool "AIRPLAY Support"
	depends on MT_AP_SUPPORT
	default n
	
config BAND_STEERING
	bool "Band Steering"
	depends on MT_AP_SUPPORT
	default n
```

## MB110V1_gpl_src/mtk_ApSoC_4320/linux-2.6.36.x/init/Kconfig.tiny
```kconfig
menuconfig TINY
	bool "Configure tiny kernel features"
	help
	  This option allows certain base kernel options and settings
	  to be disabled or tweaked. This is for specialized
	  environments which can tolerate a "non-standard" tiny kernel.
	  Only use this if you really know what you are doing.


config NET_SMALL
	default n
	bool "Enable various size reductions for networking" if TINY
	help
	  This reduces the size of miscellaneous networking data structures.
	   a placeholder.


config BINFMT_ELF_AOUT
	bool "ELF binaries with a.out linkage" if TINY
	depends on BINFMT_ELF
	default BINFMT_AOUT
	help
	  The kernel may support ELF executables which use an a.out format
	  interpreter (dynamic linker) and/or a.out shared libraries, in
	  addition to the usual ELF-ELF setups. You shouldn't need this.


config ETHTOOL
	bool "Enable ethtool support" if TINY
	default n
	depends on NET
	help
	  Disabling this option removes support for configuring
	  ethernet device features via ethtool.


config IGMP
	depends on NET
	default y
	bool "Enable IGMP support" if TINY
	help
	  This includes support for the Internet group management
	  protocol, used for multicast.

config INETPEER
	default y
	bool "Enable INET peer information storage" if TINY
	help
	  This allows storing various information about network peers.
	  Disabling saves about 2k.

config MEMPOOL
	default y
	bool "Use mempool allocator" if TINY
	help
	  The mempool allocator attempts keep a reserve pool of
	  various objects available for use in low-memory situations.
	  Disabling this feature may make more memory available and
	  will somewhat decrease code size, but with a higher risk of
	  deadlock under some loads.

config NET_SK_FILTER
        default y
	depends on NET
	bool "Enable network socket filter" if TINY
	help
	  This enables the basic kernel level socket filtering, not to
	  be confused with netfilter. Required by PPP.

config XATTR
	default y
	bool "Enable filesystem extended attribute support" if TINY
	help
	  This enables the filesystem extended attribute syscalls.

#
# MTK/Ralink -- can't apply this patch in 2.6.36 with gcc 4.6.3
#               TODO: try to fix if possible. 
#
#config PANIC
#	default y
#	bool "Enable panic reporting code" if TINY
#	help
#	  Disabling this completely removes panic handling code.
#          Warning: this can result in data loss if a panic condition
#          occurs, as the kernel may ignore the condition entirely.

config FULL_PANIC
	default y
	bool "Full panic reporting data" if TINY
	help
	  This includes text descriptions of panics in addition to stack dumps.
          Disabling compiles out the explanations for panics, saving
	  string space. Use with caution.


config NR_LDISCS
	int "Number of tty line disciplines" if TINY
	range 0 16
	default 16
	help
	  Select the maximum number of tty line disciplines. Embedded systems
          can probably get by with only a few of these.


config MAX_SWAPFILES_SHIFT
	int "Number of swap files log2 (0 => 1, 5 => 32)" if TINY
	range 0 5
	default 5
	help
	  Select the maximum number of swapfiles (5 for default).


config MAX_USER_RT_PRIO
	int "Number of realtime priority levels" if TINY
	range 5 100
	default 100
	help
	  This option allows reducing the size of the O(1) scheduler arrays.
```

## MB110V1_gpl_src/mtk_ApSoC_4320/linux-2.6.36.x/net/nat/fast-classifier/Kconfig
```kconfig
# Copyright (c) 2013 Qualcomm Atheros, Inc.
#
# All Rights Reserved.
# Qualcomm Atheros Confidential and Proprietary.
#
# Fast-classifier
#

config FAST_CLASSIFIER
	tristate "Fast-classifier for shortcut Forwarding Engine"
	depends on SHORTCUT_FE
	---help---
	  Fast-classifier is another implementation of Shortcut Forwarding Engine.

	  To compile this code as a module, choose M here: the module will be
	  called shortcut-fe.

	  If unsure, say N.
```
